## CMakeLists.txt
```
# SPDX-License-Identifier: Apache-2.0

cmake_minimum_required(VERSION 3.20.0)

find_package(Zephyr REQUIRED HINTS $ENV{ZEPHYR_BASE})
project(adc_respiratory)

target_sources(app PRIVATE src/main.c src/ble_send.c src/adc_control.c src/ppi_config.c src/storage_nvs.c src/battery.c)
```

## prj.conf
```kconfig
#CONFIG_LOG_PROCESS_THREAD_SLEEP_MS=100

#CONFIG_GPIO=y
CONFIG_NRFX_GPIOTE0=y
CONFIG_NRFX_SAADC=y
CONFIG_NRFX_RTC2=y
CONFIG_GPIO=y
CONFIG_CBPRINTF_FP_SUPPORT=y
#CONFIG_ADC=y


#memory
CONFIG_FLASH=y
CONFIG_FLASH_PAGE_LAYOUT=y
CONFIG_FLASH_MAP=y
CONFIG_NVS=y
CONFIG_NORDIC_QSPI_NOR=y
CONFIG_HEAP_MEM_POOL_SIZE=2048
CONFIG_PM_DEVICE=y
CONFIG_RING_BUFFER=y
#CONFIG_PARTITION_MANAGER_EN

#bluetooth
CONFIG_BT=y
CONFIG_SETTINGS=y
CONFIG_BT_SMP=y
CONFIG_BT_SIGNING=y
CONFIG_BT_PERIPHERAL=y
CONFIG_BT_ATT_PREPARE_COUNT=5
CONFIG_BT_BAS=y

CONFIG_BT_DEVICE_NAME="UU_SAADC"
CONFIG_BT_DEVICE_APPEARANCE=541
CONFIG_BT_DEVICE_NAME_DYNAMIC=n
CONFIG_BT_SETTINGS=y
CONFIG_BT_USER_DATA_LEN_UPDATE=y

CONFIG_BT_BUF_ACL_RX_SIZE=83
CONFIG_BT_L2CAP_TX_MTU=83
CONFIG_BT_L2CAP_DYNAMIC_CHANNEL=y
CONFIG_BT_BUF_ACL_TX_COUNT=10
CONFIG_BT_BUF_ACL_TX_SIZE=83

#CONFIG_HEAP_MEM_POOL_SIZE=2048

CONFIG_GPIO=y
#CONFIG_NRFX_PWM=y

#power 
CONFIG_USB_DEVICE_STACK=n
```

## debug.conf
```kconfig
#debug
CONFIG_LOG=y
CONFIG_RTT_CONSOLE=y
CONFIG_USE_SEGGER_RTT=y
CONFIG_CBPRINTF_FP_SUPPORT=y
CONFIG_CORTEX_M_DEBUG_MONITOR_HOOK=y
CONFIG_SEGGER_DEBUGMON=y
CONFIG_DEBUG_OPTIMIZATIONS=y
CONFIG_DEBUG_THREAD_INFO=y
CONFIG_LOG_FUNC_NAME_PREFIX_ERR=y

CONFIG_USB_CDC_ACM_LOG_LEVEL_OFF=n
```

## src/adc_control.c
```c
/*
 * Copyright (c) 2022 - 2024, Nordic Semiconductor ASA
 * All rights reserved.
 *
 * SPDX-License-Identifier: BSD-3-Clause
 *
*/

#include <zephyr/kernel.h>
#include "adc_control.h"
#include <nrfx_saadc.h>
#include <nrfx_gpiote.h>
#include <zephyr/logging/log.h>
#include <zephyr/drivers/gpio.h>                                                                                                                                                     

#include "ble_send.h"

LOG_MODULE_REGISTER(SAADC_MODULE, CONFIG_LOG_DEFAULT_LEVEL);


const struct device *const gpio1_dev = DEVICE_DT_GET(DT_NODELABEL(gpio1));
struct k_mutex saadc_mutex;

//K_HEAP_DEFINE(BUFFER,512);


/**
 * @defgroup nrfx_saadc_advanced_non_blocking_internal_timer_example Advanced non-blocking sampling with internal timer SAADC example
 * @{
 * @ingroup nrfx_saadc_examples
 *
 * @brief Example showing advanced functionality of nrfx_saadc driver operating in the non-blocking continuous sampling mode with internal timer.
 *
 * @details Application initializes nrfx_saadc driver and starts operating in the non-blocking mode.
 *          In the example, @ref m_single_channel is configured and the SAADC driver is set to the advanced mode
 *          with @p nrfx_saadc_adv_config_t::start_on_end enabled. With that flag @p NRF_SAADC_TASK_START task
 *          is triggered on the @p NRF_SAADC_EVENT_END event automatically by the SAADC driver.
 *
 *          Calibration in a non-blocking manner is triggered by @p nrfx_saadc_offset_calibrate. Then, upon receiving @p NRFX_SAADC_EVT_CALIBRATEDONE
 *          event in @ref saadc_handler() sampling is initiated by calling @p nrfx_saadc_mode_trigger() function.
 *          Consecutive sample tasks are triggered by the internal timer at the sample rate specified in  @ref SAADC_SAMPLE_FREQUENCY symbol.
 *
 *          The example features GPPI channel configured to test the functionality of SAADC. The endpoints are setup up in a way
 *          that @p NRF_SAADC_EVENT_RESULTDONE event is connected with the GPIOTE task that toggles the @ref OUT_GPIO_PIN pin.
 *
 *          Please note that the internal timer can only be used in the non-blocking mode with only a single input channel enabled.
 */

/** @brief Symbol specifying GPIOTE instance to be used. */
#define GPIOTE_INST_IDX 0

/** @brief Symbol specifying GPIO pin used to test the functionality of SAADC. */
//#define OUT_GPIO_PIN LOOPBACK_PIN_1B

/** @brief Acquisition time [us] for source resistance <= 800 kOhm (see SAADC electrical specification). */
#define ACQ_TIME_10K 40UL

/** @brief Conversion time [us] (see SAADC electrical specification). */
#define CONV_TIME 2UL

/** @brief Internal timer frequency [Hz] is derived from PCLK16M (see SAMPLERATE register in SAADC). */
#define INTERNAL_TIMER_FREQ 16000000UL

/** @brief SAADC sample frequency for the continuous sampling. */
#define SAADC_SAMPLE_FREQUENCY 8000UL // 8000UL

/** @brief Internal timer capture and compare value. */
#define INTERNAL_TIMER_CC (INTERNAL_TIMER_FREQ / SAADC_SAMPLE_FREQUENCY)

/**
 * @brief Symbol specifying the number of sample buffers ( @ref m_sample_buffers ).
 * Two buffers are required for performing double-buffered conversions.
 */
#define BUFFER_COUNT 2U

/** @brief Symbol specifying the size of singular sample buffer ( @ref m_sample_buffers ). */
//#define BUFFER_SIZE 5UL //means 40Hz

/** @brief SAADC channel configuration structure for single channel use. */
static const nrfx_saadc_channel_t m_single_channel = SAADC_CHANNEL_SE_ACQ_40US(NRF_SAADC_INPUT_AIN0, NRF_SAADC_INPUT_AIN1, 0);

/** @brief Samples buffer to store values from a single channel ( @ref m_single_channel). */

#define MESSAGE_NUM 5U

static uint16_t m_sample_buffers[BUFFER_COUNT][MESSAGE_NUM];


/** For continuous sampling the sample rate SAADC_SAMPLE_FREQUENCY should fulfill the following criteria (see SAADC Continuous sampling). */
NRFX_STATIC_ASSERT(SAADC_SAMPLE_FREQUENCY <= (1000000UL / (ACQ_TIME_10K + CONV_TIME)));

/** Possible range value of a CC field in the SAMPLERATE register (SAADC) is 80-2047. */
NRFX_STATIC_ASSERT((INTERNAL_TIMER_CC >= 80UL ) && (INTERNAL_TIMER_CC <= 2047UL));

/**
 * @brief Function for handling SAADC driver events.
 *
 * @param[in] p_event Pointer to an SAADC driver event.
 */


int16_t result_items[MESSAGE_NUM] = {0};

static bool continuereading = false;

void adc_stop() {
    continuereading = false;
    
    k_mutex_unlock(&saadc_mutex);  
    nrfx_saadc_uninit();      
}

static void saadc_handler(nrfx_saadc_evt_t const * p_event)
{
    nrfx_err_t status;
    (void)status;

    static uint16_t buffer_index = 1;

    
    uint16_t samples_number;

    switch (p_event->type)
    {
        case NRFX_SAADC_EVT_CALIBRATEDONE:
            LOG_INF("SAADC event: CALIBRATEDONE");

            status = nrfx_saadc_mode_trigger();
            NRFX_ASSERT(status == NRFX_SUCCESS);
            break;

        case NRFX_SAADC_EVT_READY:
            LOG_INF("SAADC event: READY");
            break;

        case NRFX_SAADC_EVT_BUF_REQ:
            LOG_INF("SAADC event: BUF_REQ");

            if (continuereading)
            {
                /* Next available buffer must be set on the NRFX_SAADC_EVT_BUF_REQ event to achieve the continuous conversion. */
                status = nrfx_saadc_buffer_set(m_sample_buffers[buffer_index++], MESSAGE_NUM);
                NRFX_ASSERT(status == NRFX_SUCCESS);
                buffer_index = buffer_index % BUFFER_COUNT;
            }
            break;

        case NRFX_SAADC_EVT_DONE:
            samples_number = p_event->data.done.size; 
            
            for (int16_t i = 0; i < samples_number; i++)
            {                
                result_items[i] = NRFX_SAADC_SAMPLE_GET(RESOLUTION, p_event->data.done.p_buffer, i);
            } 
            SendBufferd(result_items, samples_number); //times 2 bc 16bit
            
            LOG_INF("first item:%d", result_items[0]);
            break;

        case NRFX_SAADC_EVT_FINISHED:
            LOG_INF("SAADC event: FINISHED");
                           
            break;

        default:
            break;
    }
}

#define NRFX_SAADC_BB_CONFIG                                           \
{                                                                               \
    .oversampling      = NRF_SAADC_OVERSAMPLE_256X,                         \
    .burst             = NRF_SAADC_BURST_DISABLED,                              \
    .internal_timer_cc = INTERNAL_TIMER_CC,                                                     \
    .start_on_end      = true,\
}

 
void adc_calibrate_and_start() {
    LOG_INF("adc_calibrate_and_start");
    
    if(k_mutex_lock(&saadc_mutex, K_MSEC(10)) != 0) {
        
        LOG_INF("mutex busy");
        return;
    };    
    //enable_saadc_irq_runtime();

    LOG_INF("mutex aquired");

    continuereading = true;
    nrfx_err_t status;
    status = nrfx_saadc_init(DT_IRQ(DT_NODELABEL(adc), priority));
    //status = nrfx_saadc_init(NRFX_SAADC_DEFAULT_CONFIG_IRQ_PRIORITY);
    NRFX_ASSERT(status == NRFX_SUCCESS);

    status = nrfx_saadc_channel_config(&m_single_channel);
    NRFX_ASSERT(status == NRFX_SUCCESS);

    nrfx_saadc_adv_config_t adv_config = NRFX_SAADC_BB_CONFIG;    
    

    uint32_t channel_mask = nrfx_saadc_channels_configured_get();
    status = nrfx_saadc_advanced_mode_set(channel_mask,
                                          NRF_SAADC_RESOLUTION_12BIT,
                                          &adv_config,
                                          saadc_handler);
    NRFX_ASSERT(status == NRFX_SUCCESS);

    status = nrfx_saadc_buffer_set(m_sample_buffers[0], MESSAGE_NUM);
    NRFX_ASSERT(status == NRFX_SUCCESS);

    
    status = nrfx_saadc_offset_calibrate(saadc_handler);
    NRFX_ASSERT(status == NRFX_SUCCESS);    
    //powerup_iopin();
}

/**
 * @brief Function for application main entry.

 */
static int configureSAADC(void)
{          
    
    k_mutex_init(&saadc_mutex);
    // IRQ_CONNECT(NRFX_IRQ_NUMBER_GET(NRF_GPIOTE_INST_GET(GPIOTE_INST_IDX)), IRQ_PRIO_LOWEST,
    //             NRFX_GPIOTE_INST_HANDLER_GET(GPIOTE_INST_IDX), 0, 0);
    IRQ_CONNECT(NRFX_IRQ_NUMBER_GET(NRF_SAADC), IRQ_PRIO_LOWEST, nrfx_saadc_irq_handler, 0, 0);
    
    LOG_INF("mutex declared");
    
    // int err = 0;
    // err |= gpio_pin_configure(gpio1_dev, 11, GPIO_OUTPUT); 
	// if(err != 0) {
	// 	LOG_ERR("error configure output pin %d", err);
	// }		

    // nrfx_gpiote_t const gpiote_inst = NRFX_GPIOTE_INSTANCE(GPIOTE_INST_IDX);
    // status = nrfx_gpiote_init(&gpiote_inst, NRFX_GPIOTE_DEFAULT_CONFIG_IRQ_PRIORITY);`
    // NRFX_ASSERT(status == NRFX_SUCCESS);
    // LOG_INF("GPIOTE status: %s", nrfx_gpiote_init_check(&gpiote_inst) ? "initialized" : "not initialized");

    // pin_on_event_toggle_setup(&gpiote_inst, OUT_GPIO_PIN,
    //                            nrf_saadc_event_address_get(NRF_SAADC, NRF_SAADC_EVENT_RESULTDONE));    
    return 0;
}

/** @} */

SYS_INIT(configureSAADC, APPLICATION, CONFIG_APPLICATION_INIT_PRIORITY);
```

## src/adc_control.h
```c
#ifndef ADC_CONTROL__
#define ADC_CONTROL__

#include <zephyr/kernel.h>

extern struct k_mutex saadc_mutex;
/**
 * @brief SAADC channel configuration for the single-ended mode with 3 us sample acquisition time.
 *        The 3 us acquisition time will work correctly when the source resistance of @p _pin_p input
 *        analog pin is less than 10 kOhm.
 *
 * This configuration sets up single-ended SAADC channel with the following options:
 * - resistor ladder disabled
 * - gain: 1/6
 * - reference voltage: internal 0.6 V
 * - sample acquisition time: 3 us
 * - burst disabled
 *
 * @param[in] _pin_p Positive input analog pin.
 * @param[in] _index Channel index.
 *
 * @sa nrfx_saadc_channel_t
 */
#define SAADC_CHANNEL_SE_ACQ_40US(_pin_n, _pin_p, _index)        \
{                                                       \
    .channel_config =                                   \
    {                                                   \
        .resistor_p = NRF_SAADC_RESISTOR_VDD1_2,      \
        .resistor_n = NRF_SAADC_RESISTOR_DISABLED,      \
        .gain       = NRF_SAADC_GAIN1,                \
        .reference  = NRF_SAADC_REFERENCE_INTERNAL,     \
        .acq_time   = NRF_SAADC_ACQTIME_40US,            \
        .mode       = NRF_SAADC_MODE_DIFFERENTIAL,      \
        .burst      = NRF_SAADC_BURST_DISABLED,         \
    },                                                  \
    .pin_p          = (nrf_saadc_input_t)_pin_p,        \
    .pin_n          = (nrf_saadc_input_t)_pin_n,        \
    .channel_index  = _index,                           \
}


extern void adc_calibrate_and_start();
extern void adc_stop();

#endif
```

## src/battery.c
```c
#include <zephyr/kernel.h>
#include <zephyr/bluetooth/services/bas.h>
#include <zephyr/drivers/gpio.h>
#include <nrfx_saadc.h>
#include <zephyr/logging/log.h>
#include "battery.h"
#include "adc_control.h"

LOG_MODULE_REGISTER(battery, LOG_LEVEL_INF);

static nrfx_saadc_channel_t channel = NRFX_SAADC_DEFAULT_CHANNEL_SE(NRF_SAADC_INPUT_AIN7, 0);
static const struct device *gpio_battery_dev = DEVICE_DT_GET(DT_NODELABEL(gpio0));

static int16_t sample;

static void battery_sample_timer_handler(struct k_timer *timer);

K_TIMER_DEFINE(battery_sample_timer, battery_sample_timer_handler, NULL);

static int configure_saadc(void);

void battery_sample_timer_handler(struct k_timer *timer)
{    
    int ret = 0;
	if(k_mutex_lock(&saadc_mutex, K_NO_WAIT) != 0) {
        LOG_INF("mutex locked, skip measure");
        return;
    }
    LOG_INF("configure saadc for measure");
    ret |= configure_saadc();
    if(ret == -1) {
        LOG_INF("mutex busy");
        return;
    }
    ret |= gpio_pin_set(gpio_battery_dev, GPIO_BATTERY_READ_ENABLE, 1);
    nrfx_err_t err = nrfx_saadc_mode_trigger();
    if (err != NRFX_SUCCESS) {
        printk("nrfx_saadc_mode_trigger error: %08x", err);
    
    }
    err = 0;
    nrfx_saadc_uninit();
    k_mutex_unlock(&saadc_mutex);

    ret |= gpio_pin_set(gpio_battery_dev, GPIO_BATTERY_READ_ENABLE, 0);
    
    int adc_mv = ((600*6) * sample) / ((1<<12));    
    uint16_t battery_millivolt = adc_mv * ((R1 + R2) / R2);
    uint8_t percentage = 0;
    battery_get_percentage(&percentage, battery_millivolt);    
    err |= bt_bas_set_battery_level(percentage);
    
    if(err != 0 ) {
        LOG_ERR("err bt set level: %d", err);        
    }

    LOG_INF("SAADC value: %d\n", sample);
    LOG_INF("Battery Voltage: %dmV\n", battery_millivolt);
    LOG_INF("Battery Percentage: %d%%\n", percentage);
    if(err) {
        LOG_ERR("err occured reading battery level %d", err);
    }
}

static BatteryState battery_states[] = {
    {4200, 100},
    {4160, 99},
    {4090, 91},
    {4030, 78},
    {3890, 63},
    {3830, 53},
    {3680, 36},
    {3660, 35},
    {3480, 14},
    {3420, 11},
    {3150, 1}, // 3240
    {0000, 0}  // Below safe level
};

static int configure_saadc(void)
{            
    nrfx_err_t err = nrfx_saadc_init(DT_IRQ(DT_NODELABEL(adc), priority));
    if (err != NRFX_SUCCESS) 
    {
            LOG_ERR("nrfx_saadc_mode_trigger error: %08x", err);
            return err;
    }
    
    channel.channel_config.gain = NRF_SAADC_GAIN1_6;

    err = nrfx_saadc_channels_config(&channel, 1);
    if (err != NRFX_SUCCESS) 
    {
        LOG_ERR("nrfx_saadc_channels_config error: %08x", err);
        return err;
    }        
    err = nrfx_saadc_simple_mode_set(BIT(0),
                                        NRF_SAADC_RESOLUTION_12BIT,
                                        NRF_SAADC_OVERSAMPLE_DISABLED,
                                        NULL);
    if (err != NRFX_SUCCESS) {
            LOG_ERR("nrfx_saadc_simple_mode_set error: %08x", err);
            return err;
    }
    
    /* STEP 5.5 - Set buffer where sample will be stored */
    err = nrfx_saadc_buffer_set(&sample, 1);
    if (err != NRFX_SUCCESS) {
            LOG_ERR("nrfx_saadc_buffer_set error: %08x", err);            
    }    
    return err;
}

int battery_get_percentage(uint8_t *battery_percentage, uint16_t battery_millivolt)
{

    // Ensure voltage is within bounds
    if (battery_millivolt > battery_states[0].voltage)
        *battery_percentage = 100;
    if (battery_millivolt < battery_states[ARRAY_SIZE(battery_states)-1].voltage)
        *battery_percentage = 0;

    for (uint8_t i = 0; i < ARRAY_SIZE(battery_states)-1; i++)
    {
        // Find the two points battery_millivolt is between
        if (battery_states[i].voltage >= battery_millivolt && battery_millivolt >= battery_states[i + 1].voltage)
        {
            // Linear interpolation
            *battery_percentage = battery_states[i].percentage +
                                  ((float)(battery_millivolt - battery_states[i].voltage) *
                                   ((float)(battery_states[i + 1].percentage - battery_states[i].percentage) /
                                    (float)(battery_states[i + 1].voltage - battery_states[i].voltage)));

            LOG_DBG("%d %%", *battery_percentage);
            return 0;
        }
    }
    return 0;
}

int battery_init()
{
    int ret = 0;

    ret |= gpio_pin_configure(gpio_battery_dev, GPIO_BATTERY_READ_ENABLE, GPIO_OUTPUT | GPIO_ACTIVE_LOW);
    ret |= gpio_pin_configure(gpio_battery_dev, GPIO_BATTERY_CHARGE_SPEED, GPIO_OUTPUT | GPIO_ACTIVE_LOW);
    ret |= gpio_pin_set(gpio_battery_dev, GPIO_BATTERY_CHARGE_SPEED, 1); // FAST charge 100mA    
    k_timer_start(&battery_sample_timer, K_NO_WAIT, K_MINUTES(2));
    
    if(ret != 0) {
        LOG_ERR("error, %d", ret);
    }    

    return ret;
}

SYS_INIT(battery_init, APPLICATION, CONFIG_APPLICATION_INIT_PRIORITY);
```

## src/battery.h
```c
#include <stdint.h>
#include <stdbool.h>

#ifndef __BATTERY_H__
#define __BATTERY_H__

#define BAS_UPDATE_FREQUENCY 120
#define GPIO_BATTERY_CHARGE_SPEED 13
#define GPIO_BATTERY_CHARGING_ENABLE 17
#define GPIO_BATTERY_READ_ENABLE 14

uint16_t R1 = 1037; // Originally 1M ohm, calibrated after measuring actual voltage values. Can happen due to resistor tolerances, temperature ect..
uint16_t R2 = 510;  // 510K ohm

typedef struct
{
    uint16_t voltage;
    uint8_t percentage;
} BatteryState;



/**
 * @brief Calculates the battery voltage using the ADC.
 *
 * @param[in] battery_millivolt Pointer to where battery voltage is stored.
 *
 * @retval 0 if successful. Negative errno number on error.
 */
int battery_get_millivolt(uint16_t *battery_millivolt);

/**
 * @brief Calculates the battery percentage using the battery voltage.
 *
 * @param[in] battery_percentage  Pointer to where battery percentage is stored.
 *
 * @param[in] battery_millivolt Voltage used to calculate the percentage of how much energy is left in a 3.7V LiPo battery.
 *
 * @retval 0 if successful. Negative errno number on error.
 */
int battery_get_percentage(uint8_t *battery_percentage, uint16_t battery_millivolt);


#endif
```

## src/ble_send.c
```c
#include <zephyr/types.h>
#include <stddef.h>
#include <string.h>
#include <errno.h>

#include <zephyr/sys/ring_buffer.h>
#include <zephyr/sys/byteorder.h>
#include <zephyr/kernel.h>

#include <zephyr/settings/settings.h>

#include <zephyr/bluetooth/bluetooth.h>
#include <zephyr/bluetooth/hci.h>
#include <zephyr/bluetooth/conn.h>
#include <zephyr/bluetooth/uuid.h>
#include <zephyr/bluetooth/gatt.h>

#include <zephyr/logging/log.h>

#include "adc_control.h"
#include "ble_send.h"
#include "ppi_config.h" 


LOG_MODULE_REGISTER(BLE_MODULE, CONFIG_LOG_DEFAULT_LEVEL);


//general service
static struct bt_uuid_128 saadc_general_prop = BT_UUID_INIT_128(
	BT_UUID_128_ENCODE(0xa5c47d93, 0x8a02, 0x4ca5, 0x976e, 0xde7b871f11f3));

//notify service 
static struct bt_uuid_128 saadc_notify_prop = BT_UUID_INIT_128(
	BT_UUID_128_ENCODE(0xd67b5503, 0xa25c, 0x4395, 0xbd21, 0xf92823d91442));

//PPI enable
static struct bt_uuid_128 ppi_prop = BT_UUID_INIT_128(
	BT_UUID_128_ENCODE(0xd60b5543, 0xa25c, 0x4395, 0xbd21, 0xf92823d91442));

static uint8_t saadc_notify_buff[50];
static uint8_t ppi_state_buff[1];
bool isConnected = false;

static ssize_t ppi_buffer_read(struct bt_conn *conn, const struct bt_gatt_attr *attr,
	void *buf, uint16_t len, uint16_t offset);

static ssize_t ppi_buffer_write(struct bt_conn *conn, const struct bt_gatt_attr *attr, const void *buf, 
		uint16_t len, uint16_t offset, uint8_t flags);

static void resp_readmotion_data_notify_changed(const struct bt_gatt_attr *attr, uint16_t value);

uint8_t notify_ble_resp_on1 = 0;

const struct bt_data ad[] = {
		BT_DATA(BT_DATA_NAME_COMPLETE, CONFIG_BT_DEVICE_NAME, sizeof(CONFIG_BT_DEVICE_NAME) - 1),
		BT_DATA_BYTES(BT_DATA_FLAGS, (BT_LE_AD_GENERAL | BT_LE_AD_NO_BREDR)),
		BT_DATA_BYTES(BT_DATA_UUID16_ALL, BT_UUID_16_ENCODE(BT_UUID_BAS_VAL)),
	};
		//BT_DATA_BYTES(BT_DATA_UUID128_ALL, motiondata_prop),
// 			BT_DATA(BT_DATA_MANUFACTURER_DATA, uniqueId, sizeof(ui))
// 	};
// }

void ppi_value_updated(struct k_work *work);
void ble_notify_changed(struct k_work *work);

BT_GATT_SERVICE_DEFINE(saadc_svc,
	BT_GATT_PRIMARY_SERVICE(&saadc_general_prop),
	
	BT_GATT_CHARACTERISTIC(&ppi_prop.uuid, 
		BT_GATT_CHRC_READ | BT_GATT_CHRC_WRITE,
		BT_GATT_PERM_READ | BT_GATT_PERM_WRITE,
		ppi_buffer_read, ppi_buffer_write, ppi_state_buff),				   
	BT_GATT_CHARACTERISTIC(&saadc_notify_prop.uuid, 
		BT_GATT_CHRC_READ | BT_GATT_CHRC_NOTIFY,
		BT_GATT_PERM_READ,
		NULL, NULL, saadc_notify_buff),	
	BT_GATT_CCC(resp_readmotion_data_notify_changed, BT_GATT_PERM_READ | BT_GATT_PERM_WRITE)
);



K_WORK_DEFINE(work_ppi_value_updated, ppi_value_updated);
static struct k_work_q work_q_ble;
RING_BUF_DECLARE(ringbuf, 255);

RING_BUF_ITEM_DECLARE(itembuf, 128);

void ble_notify(struct k_work *work);

K_WORK_DEFINE(work_ble_notify, ble_notify);
K_WORK_DEFINE(work_ble_notify_changed, ble_notify_changed);
K_THREAD_STACK_DEFINE(threatstack_notifyen, 1024);

void SendBufferd(int16_t *data, uint32_t size) {
	uint8_t tempbuf[size*2];

	for(uint8_t x = 0; x<size; x++) {		
		tempbuf[x * 2] = ((uint16_t)data[x]) & 0xFF;
		tempbuf[x *2 + 1] = ((uint16_t)data[x] >> 8) & 0xFF;
	}
	
	ring_buf_put(&ringbuf, tempbuf, size*2);
	k_work_submit_to_queue(&work_q_ble, &work_ble_notify);	
}

void ble_notify_changed(struct k_work *work) {
	//ppi start for plant
	(notify_ble_resp_on1 ? adc_calibrate_and_start : adc_stop)();
}

static uint8_t saadcdata_ble_buff[50] = {0};

K_MUTEX_DEFINE(MUT_ble_notify);


void ble_notify(struct k_work *work) {
	LOG_INF("ble_notify");
	if(!isConnected) return;
	if(!notify_ble_resp_on1) return;
	if (k_mutex_lock(&MUT_ble_notify, K_NO_WAIT) == 0) {		
		LOG_INF("mutex aquired");
		uint8_t enqueued_ringbuffer = ring_buf_get(&ringbuf, saadcdata_ble_buff, sizeof(saadcdata_ble_buff));

		struct bt_gatt_attr *notify_attr = bt_gatt_find_by_uuid(saadc_svc.attrs, saadc_svc.attr_count, &saadc_notify_prop.uuid);	
		struct bt_gatt_notify_params params = {
			.attr = notify_attr,
			.data = saadcdata_ble_buff,
			.len  = enqueued_ringbuffer,
		    //.func = notify_complete_cb, 
		};

		int ret = bt_gatt_notify_cb(NULL, &params);
		if(ret < 0) {
			LOG_ERR("error notify data %d", ret);
		}
		
		LOG_INF("notifications send, amount: %d", enqueued_ringbuffer);
		k_sleep(K_MSEC(50));				
		k_mutex_unlock(&MUT_ble_notify);
		if(!ring_buf_is_empty(&ringbuf)){
			LOG_INF("ringbuf was filled after delay");
			k_work_submit_to_queue(&work_q_ble, &work_ble_notify);			
		}		
	}	
}

void mtu_updated(struct bt_conn *conn, uint16_t tx, uint16_t rx)
{
	LOG_INF("Updated MTU: TX: %d RX: %d bytes\n", tx, rx);
}

static struct bt_gatt_cb gatt_callbacks = {
	.att_mtu_updated = mtu_updated
};



static struct bt_conn *current_conn = NULL;
static void connected(struct bt_conn *conn, uint8_t err)
{
	if (err) {
		LOG_INF("Connection failed (err 0x%02x)\n", err);
	} else {
		isConnected = true;
		LOG_INF("Connected\n");
		current_conn = bt_conn_ref(conn);
		/* Request updated connection parameters with shorter supervision timeout */
        int ret = bt_conn_le_param_update(conn, BT_LE_CONN_PARAM_DEFAULT);
		if(ret != 0) {
			LOG_ERR("error updating connection params %d", ret);
		}
	}
}

static void disconnected(struct bt_conn *conn, uint8_t reason)
{
	LOG_INF("Disconnected (reason 0x%02x)\n", reason);
	isConnected = false;
	notify_ble_resp_on1 = false;
	if (current_conn) {
		bt_conn_unref(current_conn);
		current_conn = NULL;
	}
	k_work_submit(&work_ble_notify_changed);
}

static void le_data_length_updated(struct bt_conn *conn, struct bt_conn_le_data_len_info *info) {
	LOG_INF("LE data len updated: TX (len: %d time: %d)"
	       " RX (len: %d time: %d)\n", info->tx_max_len,
	       info->tx_max_time, info->rx_max_len, info->rx_max_time);
}

static void param_updated(struct bt_conn *conn, uint16_t interval,
				 uint16_t latency, uint16_t timeout) {
					LOG_INF("interval: %d, latency %d, timeout %d", interval, latency, timeout);
				 }

BT_CONN_CB_DEFINE(conn_callbacks) = {
	.connected = connected,
	.disconnected = disconnected,
	.le_data_len_updated = le_data_length_updated,
	.le_param_updated = param_updated,
};

static void resp_readmotion_data_notify_changed(const struct bt_gatt_attr *attr, uint16_t value) {
	LOG_INF("resp_notify_changed");
	notify_ble_resp_on1 = (value == BT_GATT_CCC_NOTIFY || value == BT_GATT_CCC_INDICATE);		 
	k_work_submit_to_queue(&work_q_ble, &work_ble_notify_changed);
}

static ssize_t ppi_buffer_write(struct bt_conn *conn, const struct bt_gatt_attr *attr, const void *buf, 
	uint16_t len, uint16_t offset, uint8_t flags) {	
	
	uint8_t *value = attr->user_data;	
	memcpy(value + offset, buf, len);
	
	k_work_submit_to_queue(&work_q_ble, &work_ppi_value_updated);
	return len;
}

static ssize_t ppi_buffer_read(struct bt_conn *conn, const struct bt_gatt_attr *attr,
	void *buf, uint16_t len, uint16_t offset) {
	
	const uint8_t *value = attr->user_data;	
	return bt_gatt_attr_read(conn, attr, buf, len, offset, value, sizeof(ppi_state_buff));
}

BT_CONN_CB_DEFINE(bt_callback);

static void bt_ready(void)
{
	int err;

	LOG_INF("Bluetooth initialized\n");	

	if (IS_ENABLED(CONFIG_SETTINGS)) {
		settings_load();
	}

	err = bt_le_adv_start(BT_LE_ADV_CONN, ad, ARRAY_SIZE(ad), NULL, 0);
	if (err) {
		LOG_ERR("Advertising failed to start (err %d)\n", err);
		return;
	}

	LOG_INF("Advertising successfully started\n");	
}



static void auth_cancel(struct bt_conn *conn)
{
	char addr[BT_ADDR_LE_STR_LEN];

	bt_addr_le_to_str(bt_conn_get_dst(conn), addr, sizeof(addr));

	LOG_INF("Pairing cancelled: %s\n", addr);
}

static struct bt_conn_auth_cb auth_cb_display = {
	.passkey_display = NULL,// auth_passkey_display,
	.passkey_entry = NULL,
	.cancel = auth_cancel,
	.passkey_confirm = NULL,	
};

void notify_changed(struct k_work *work) {
	(notify_ble_resp_on1 == 1 ? adc_calibrate_and_start : adc_stop)();
	LOG_INF("notify changed to %d", notify_ble_resp_on1);
}

void ppi_value_updated(struct k_work *work) {
	(ppi_state_buff[0] == 1 ? ppi_start : ppi_stop)();
	LOG_INF("ppi state updated: %d", ppi_state_buff[0]);
}

int ble_init()
{		
	int err;
	k_work_queue_init(&work_q_ble);

	k_work_queue_start(&work_q_ble, threatstack_notifyen,
		K_THREAD_STACK_SIZEOF(threatstack_notifyen), 95,
		NULL);	

	err = bt_enable(NULL);
	if (err) {
		LOG_INF("Bluetooth init failed (err %d)\n", err);
		return 0;
	}

	bt_ready();

	bt_gatt_cb_register(&gatt_callbacks);
	bt_conn_auth_cb_register(&auth_cb_display);

	//clean up bonds
	bt_unpair(BT_ID_DEFAULT, BT_ADDR_LE_ANY);
	
	return err;
}



//void ble_notify_respiratory_proc(int16_t adcitems[]) {		
	// struct bt_gatt_attr *notify_attr = bt_gatt_find_by_uuid(motion_svc.attrs, motion_svc.attr_count, &respiratory_notify_prop.uuid);
	    
    //     if(notify_ble_resp_on1){

	// 		size_t packed_size;        

	// 		encode_data(adcitems, respiratory_notify_buff, &packed_size);
	// 		LOG_INF("notify:");
//			bt_gatt_notify(NULL, notify_attr, respiratory_notify_buff, packed_size);			
//		}    
//}


// K_THREAD_DEFINE(ble_sender, 2048, ble_notify_respiratory_proc,  NULL, NULL, NULL, 7, 0, 0);
SYS_INIT(ble_init, APPLICATION, CONFIG_APPLICATION_INIT_PRIORITY);
```

## src/ble_send.h
```c
#ifndef BLE_SEND__
#define BLE_SEND__
#include <zephyr/types.h>


void SendBufferd(int16_t *data, uint32_t size);



#endif
```

## src/ppi_config.c
```c
#include <zephyr/kernel.h>
#include <zephyr/sys/printk.h>
#include <zephyr/drivers/gpio.h>
#include <zephyr/device.h>
#include <zephyr/logging/log.h>

   /* Copyright (c) 2013 Nordic Semiconductor. All Rights Reserved.
 *
 * Use of this source code is governed by a BSD-style license that can be
 * found in the license.txt file.
 */
/*
 * See README.md for a description of the application. 
 */ 
LOG_MODULE_REGISTER(PPI_MODULE, CONFIG_LOG_DEFAULT_LEVEL);


void ppi_start() {
    NRF_TIMER1->TASKS_START = 1;
    LOG_INF("ppi started");
}

void ppi_stop() {
    NRF_TIMER1->TASKS_STOP = 1;
    LOG_INF("ppi stopped");
}
/**
 * @brief Function for application main entry.
 */
int ppi_init(void)
{   
    NRF_CLOCK->TASKS_HFCLKSTART = 1;
    while (NRF_CLOCK->EVENTS_HFCLKSTARTED == 0)
    {
        LOG_INF("waiting HFCLK start");
        k_sleep(K_MSEC(10));        
    }
    NRF_CLOCK->EVENTS_HFCLKSTARTED = 0;
    
    // Workaround for PAN item 11, nRF51822-PAN v2.0.pdf. Not needed on second revision chips. 
    //NRF_POWER->TASKS_CONSTLAT = 1;
    
    NRF_GPIOTE->CONFIG[0] = GPIOTE_CONFIG_MODE_Task << GPIOTE_CONFIG_MODE_Pos |
                            GPIOTE_CONFIG_POLARITY_Toggle << GPIOTE_CONFIG_POLARITY_Pos |
                            4 << GPIOTE_CONFIG_PSEL_Pos | //pin 0. 4
                            GPIOTE_CONFIG_OUTINIT_Low << GPIOTE_CONFIG_OUTINIT_Pos;
                            
    NRF_TIMER1->PRESCALER = 0;
    // Adjust the output frequency by adjusting the CC. 
    // Due to PAN item 33, you can't have this at 1 for first revision chips, and will hence be limited to 4 MHz. 
    NRF_TIMER1->CC[0] = 1;
    NRF_TIMER1->SHORTS = TIMER_SHORTS_COMPARE0_CLEAR_Enabled << TIMER_SHORTS_COMPARE0_CLEAR_Pos;
    //NRF_TIMER1->TASKS_START = 1;
    
    NRF_PPI->CH[0].EEP = (uint32_t) &NRF_TIMER1->EVENTS_COMPARE[0];
    NRF_PPI->CH[0].TEP = (uint32_t) &NRF_GPIOTE->TASKS_OUT[0];
    
    NRF_PPI->CHENSET = PPI_CHENSET_CH0_Enabled << PPI_CHENSET_CH0_Pos;

    ppi_stop();
    return 0;
}



SYS_INIT(ppi_init, APPLICATION, CONFIG_APPLICATION_INIT_PRIORITY);
/** @} */
```

## src/ppi_config.h
```c
#ifndef __PPI_CONFIG_H
#define __PPI_CONFIG_H

//start signal 
void ppi_start();
void ppi_stop();

#endif
```

## src/storage_nvs.c
```c
#include <zephyr/kernel.h>
#include <zephyr/sys/util.h>
#include <zephyr/logging/log.h>
#include <zephyr/drivers/flash.h>
#include <zephyr/storage/flash_map.h>
#include <zephyr/fs/nvs.h>


#include <zephyr/pm/device.h>
#include <zephyr/bluetooth/bluetooth.h>
#include <zephyr/bluetooth/hci.h>
#include <zephyr/bluetooth/conn.h>
#include <zephyr/bluetooth/uuid.h>
#include <zephyr/bluetooth/gatt.h>

#include "storage_nvs.h"

static struct nvs_fs fs;

LOG_MODULE_REGISTER(STORAGE_MODULE, CONFIG_LOG_DEFAULT_LEVEL);

const struct device *spi_flash_dev;

int write_uniqueIdentifier(uint16_t *identifier) {
	nvs_write(&fs, NVS_DEVICE_ID, identifier, sizeof(uint16_t) );
	return 0;
}

int read_uniqueidentifier(uint16_t *identifier) {
	nvs_read(&fs, NVS_DEVICE_ID, identifier, sizeof(uint16_t) );
	return 0;
}

static int flash_set_suspend() {  
	

	int ret = pm_device_action_run(spi_flash_dev, PM_DEVICE_ACTION_SUSPEND);
	if(ret) { 
		LOG_ERR("could not suspend qspi flash device %d, %s", ret, spi_flash_dev->name);
		return ret;	
	}
	
	LOG_INF("qspi suspended");
	// ret = pm_device_action_run(spi_flash_dev, PM_DEVICE_ACTION_TURN_OFF);
	// if(ret) {
	// 	LOG_ERR("could not turn of qspi flash, %d, %s", ret, spi_flash_dev->name);
	// 	return ret;
	// }		
	// LOG_INF("qspi turned off");
	
	return 0;
}

int init_external_storage(void) {	
	LOG_INF("init storage");
    int rc = 0;	
	#ifdef CONFIG_BOARD_XIAO_BLE
	spi_flash_dev = DEVICE_DT_GET(DT_ALIAS(spi_flash0));	
	if (!device_is_ready(spi_flash_dev)) {
		LOG_ERR("%s: device not ready.\n", spi_flash_dev->name);
		return rc;
	}
	
    struct flash_pages_info info;

	LOG_INF("flash device found: %s", spi_flash_dev->name);	
	
	rc = flash_get_page_info_by_offs(spi_flash_dev, 0, &info);
	if (rc) {
		LOG_ERR("Unable to get page info\n");
		return rc;
	}
		
	rc |= flash_set_suspend();	
	#endif
	return rc;
}


int init_internal_storage() {
    
	LOG_INF("init internal storage");
	const struct device *flash_dev = STORAGE_PARTITION_DEVICE;
	
	if (!device_is_ready(flash_dev)) {
		LOG_ERR("%s: device not ready.\n", flash_dev->name);
		return ENODEV;
	}
	fs.flash_device = flash_dev;
    int rc = 0;	

    struct flash_pages_info info;

	LOG_INF("flash device found: %s", fs.flash_device->name);
		
	fs.offset = 0xfe000; 			
	
	rc = flash_get_page_info_by_offs(fs.flash_device, fs.offset, &info);
	if (rc) {
		LOG_ERR("Unable to get page info\n");
		return -1;
	}
  

	fs.sector_size = info.size;
	fs.sector_count = 0x2000 / info.size; 

	// todo:implement nvs
	rc = nvs_mount(&fs);
	LOG_INF("fs sector size = %d", info.size);
	if (rc) {
		LOG_ERR("Flash Init failed\n");
		return -1;
	}  		

	return rc;
}

int init_storage_module() {
	int err = 0;
	err |= init_external_storage();
	if(err) {
		LOG_ERR("init storage failed");
	}
	err |= init_internal_storage();
	if(err) {
		LOG_ERR("init internal storage failed");
	}
	return err;
}

SYS_INIT(init_storage_module, APPLICATION, CONFIG_APPLICATION_INIT_PRIORITY);
```
